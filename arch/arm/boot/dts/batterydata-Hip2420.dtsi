qcom,Hip2420-batterydata {
	qcom,battery-type = "Hip2420";
	qcom,batt-id-kohm = <47>;
	qcom,chg-term-ua = <100000>;
	qcom,default-rbatt-mohm = <178>;
	qcom,fcc-mah = <2420>;
	qcom,max-voltage-uv = <4350000>;
	qcom,rbatt-capacitive-mohm = <0>;
	qcom,v-cutoff-uv = <3400000>;

	qcom,fcc-temp-lut {
		qcom,lut-col-legend = <(-20) 0 25 40 60>;
		qcom,lut-data = <2361 2396 2404 2403 2394>;
	};

	qcom,pc-temp-ocv-lut {
		qcom,lut-col-legend = <(-20) 0 25 40 60>;
		qcom,lut-row-legend = <100 95 90 85 80>,
					<75 70 65 60 55>,
					<50 45 40 35 30>,
					<25 20 16 13 11>,
					<10 9 8 7 6>,
					<5 4 3 2 1>,
					<0>;
		qcom,lut-data = <4334 4332 4327 4324 4316>,
				<4184 4234 4249 4250 4246>,
				<4094 4162 4186 4188 4186>,
				<4020 4100 4128 4132 4132>,
				<3948 4051 4080 4086 4087>,
				<3896 3986 4038 4044 4044>,
				<3852 3942 3996 4000 3999>,
				<3819 3901 3948 3956 3956>,
				<3798 3864 3892 3898 3898>,
				<3782 3833 3858 3862 3863>,
				<3764 3804 3830 3834 3836>,
				<3744 3782 3807 3811 3812>,
				<3722 3765 3786 3790 3791>,
				<3698 3747 3768 3768 3760>,
				<3668 3723 3748 3744 3734>,
				<3630 3694 3718 3714 3703>,
				<3577 3674 3684 3680 3672>,
				<3520 3654 3672 3671 3662>,
				<3466 3629 3656 3652 3637>,
				<3418 3599 3618 3616 3600>,
				<3392 3578 3594 3592 3576>,
				<3359 3546 3564 3562 3546>,
				<3322 3510 3530 3529 3514>,
				<3279 3466 3494 3495 3484>,
				<3233 3419 3458 3462 3456>,
				<3186 3369 3424 3428 3423>,
				<3142 3324 3384 3386 3380>,
				<3104 3270 3331 3334 3326>,
				<3072 3203 3260 3260 3251>,
				<3040 3120 3160 3155 3138>,
				<3000 3012 3000 3000 3005>;
	};

	qcom,rbatt-sf-lut {
		qcom,lut-col-legend = <(-20) 0 25 40 60>;
		qcom,lut-row-legend = <100 95 90 85 80>,
					<75 70 65 60 55>,
					<50 45 40 35 30>,
					<25 20 16 13 11>,
					<10 9 8 7 6>,
					<5 4 3 2 1>;
		qcom,lut-data = <1218 340 100 74 62>,
				<1218 340 100 74 62>,
				<1124 345 104 76 63>,
				<1053 342 108 79 65>,
				<993 340 114 83 67>,
				<968 310 120 84 69>,
				<951 299 127 88 71>,
				<948 290 122 97 76>,
				<975 284 100 78 66>,
				<1025 282 97 74 64>,
				<1084 280 97 76 65>,
				<1140 284 100 79 68>,
				<1200 303 103 80 70>,
				<1266 339 102 78 65>,
				<1349 374 102 75 63>,
				<1544 416 106 75 63>,
				<2052 494 106 75 64>,
				<2747 579 119 83 69>,
				<3493 637 143 93 77>,
				<4152 653 147 101 84>,
				<4522 646 144 104 88>,
				<4652 598 145 106 92>,
				<5456 608 151 109 93>,
				<6612 624 161 114 97>,
				<8728 646 176 122 102>,
				<11880 683 200 131 104>,
				<16314 737 229 144 114>,
				<22822 828 270 166 126>,
				<32172 1415 367 215 151>,
				<45804 2830 735 392 263>;
	};
};
