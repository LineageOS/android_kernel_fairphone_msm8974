qcom,Hip2440-batterydata {
	qcom,battery-type = "Hip2440";
	qcom,batt-id-kohm = <100>;
	qcom,chg-term-ua = <100000>;
	qcom,default-rbatt-mohm = <164>;
	qcom,fcc-mah = <2440>;
	qcom,max-voltage-uv = <4400000>;
	qcom,rbatt-capacitive-mohm = <50>;
	qcom,v-cutoff-uv = <3400000>;

	qcom,fcc-temp-lut {
		qcom,lut-col-legend = <(-20) 0 25 40 60>;
		qcom,lut-data = <2506 2500 2498 2498 2494>;
	};

	qcom,pc-temp-ocv-lut {
		qcom,lut-col-legend = <(-20) 0 25 40 60>;
		qcom,lut-row-legend = <100 95 90 85 80>,
					<75 70 65 60 55>,
					<50 45 40 35 30>,
					<25 20 16 13 11>,
					<10 9 8 7 6>,
					<5 4 3 2 1>,
					<0>;
		qcom,lut-data = <4390 4378 4372 4368 4360>,
				<4256 4298 4303 4301 4295>,
				<4176 4232 4243 4242 4236>,
				<4108 4170 4184 4184 4178>,
				<4058 4110 4128 4127 4123>,
				<3974 4054 4073 4074 4070>,
				<3926 3992 4021 4024 4020>,
				<3884 3940 3968 3976 3974>,
				<3848 3902 3920 3928 3928>,
				<3818 3866 3879 3880 3880>,
				<3798 3834 3847 3848 3846>,
				<3778 3806 3821 3822 3820>,
				<3760 3784 3800 3801 3799>,
				<3741 3764 3780 3782 3780>,
				<3719 3750 3764 3763 3758>,
				<3695 3736 3749 3745 3733>,
				<3666 3720 3731 3726 3712>,
				<3642 3704 3712 3706 3692>,
				<3622 3690 3695 3686 3673>,
				<3607 3680 3687 3679 3667>,
				<3598 3674 3685 3677 3666>,
				<3586 3666 3682 3675 3663>,
				<3572 3655 3680 3673 3661>,
				<3556 3643 3675 3669 3656>,
				<3538 3628 3667 3660 3646>,
				<3516 3606 3648 3639 3616>,
				<3487 3576 3608 3594 3570>,
				<3450 3534 3550 3535 3508>,
				<3396 3470 3469 3454 3422>,
				<3300 3355 3342 3326 3291>,
				<3000 3000 3000 3000 3000>;
	};

	qcom,rbatt-sf-lut {
		qcom,lut-col-legend = <(-20) 0 25 40 60>;
		qcom,lut-row-legend = <100 95 90 85 80>,
					<75 70 65 60 55>,
					<50 45 40 35 30>,
					<25 20 16 13 11>,
					<10 9 8 7 6>,
					<5 4 3 2 1>;
		qcom,lut-data = <1281 313 100 78 70>,
				<1278 313 100 78 70>,
				<1162 310 102 80 71>,
				<1088 309 105 81 72>,
				<1066 307 109 83 73>,
				<985 305 112 85 74>,
				<978 303 114 88 76>,
				<985 304 113 90 79>,
				<984 301 105 89 79>,
				<986 301 101 80 73>,
				<1006 301 100 79 71>,
				<1034 302 101 79 73>,
				<1070 304 101 80 73>,
				<1113 306 101 80 73>,
				<1164 310 101 79 73>,
				<1212 317 101 79 71>,
				<1254 330 102 79 72>,
				<1302 343 102 79 73>,
				<1387 351 101 79 71>,
				<1436 353 101 79 71>,
				<1502 359 102 80 74>,
				<1672 366 104 82 75>,
				<1840 376 107 84 79>,
				<2078 386 110 87 82>,
				<2396 401 115 90 83>,
				<2841 419 114 88 76>,
				<3449 446 110 84 77>,
				<4402 490 110 84 77>,
				<5980 578 116 88 80>,
				<9369 896 146 122 161>;
	};
};
