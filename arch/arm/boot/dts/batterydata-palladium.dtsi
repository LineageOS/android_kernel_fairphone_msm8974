/* Copyright (c) 2013, The Linux Foundation. All rights reserved.
 *
 * This program is free software; you can redistribute it and/or modify
 * it under the terms of the GNU General Public License version 2 and
 * only version 2 as published by the Free Software Foundation.
 *
 * This program is distributed in the hope that it will be useful,
 * but WITHOUT ANY WARRANTY; without even the implied warranty of
 * MERCHANTABILITY or FITNESS FOR A PARTICULAR PURPOSE.  See the
 * GNU General Public License for more details.
 */

qcom,palladium-batterydata {
	qcom,fcc-mah = <2420>;
	qcom,default-rbatt-mohm = <166>;
	qcom,rbatt-capacitive-mohm = <0>;
	qcom,flat-ocv-threshold-uv = <3800000>;
	qcom,max-voltage-uv = <4350000>;
	qcom,v-cutoff-uv = <3400000>;
	qcom,chg-term-ua = <100000>;
	qcom,batt-id-kohm = <75>;

	qcom,fcc-temp-lut {
		qcom,lut-col-legend = <(-20) 0 25 40 60>;
		qcom,lut-data = <2324 2352 2366 2364 2352>;
	};

	qcom,pc-temp-ocv-lut {
		qcom,lut-col-legend = <(-20) 0 25 40 60>;
		qcom,lut-row-legend = <100 95 90 85 80>,
				<75 70 65 60 55>,
				<50 45 40 35 30>,
				<25 20 16 13 11>,
				<10 9 8 7 6>,
				<5 4 3 2 1>,
				<0>;
	qcom,lut-data = <4334 4330 4323 4315 4306>,
			<4155 4218 4241 4242 4238>,
			<4044 4140 4176 4180 4178>,
			<3957 4072 4119 4124 4124>,
			<3896 4005 4068 4077 4080>,
			<3853 3952 4026 4036 4038>,
			<3824 3910 3983 3992 3992>,
			<3804 3874 3931 3944 3946>,
			<3785 3842 3885 3892 3894>,
			<3766 3813 3852 3856 3859>,
			<3745 3788 3824 3830 3832>,
			<3720 3770 3800 3805 3807>,
			<3691 3752 3779 3782 3784>,
			<3656 3732 3760 3761 3756>,
			<3612 3710 3739 3738 3728>,
			<3558 3686 3710 3708 3697>,
			<3492 3658 3682 3680 3670>,
			<3432 3626 3666 3666 3656>,
			<3379 3588 3641 3644 3635>,
			<3332 3547 3608 3608 3590>,
			<3306 3523 3580 3580 3566>,
			<3278 3494 3551 3551 3536>,
			<3244 3462 3517 3519 3506>,
			<3210 3424 3481 3484 3477>,
			<3176 3377 3444 3452 3448>,
			<3144 3324 3408 3419 3414>,
			<3119 3268 3368 3378 3371>,
			<3091 3211 3316 3326 3317>,
			<3064 3150 3246 3254 3242>,
			<3036 3081 3149 3151 3136>,
			<3000 3000 3000 3000 3000>;
	};

	qcom,rbatt-sf-lut {
		qcom,lut-col-legend = <(-20) 0 25 40 60>;
		qcom,lut-row-legend = <100 95 90 85 80>,
				<75 70 65 60 55>,
				<50 45 40 35 30>,
				<25 20 16 13 11>,
				<10 9 8 7 6>,
				<5 4 3 2 1>,
				<0>;
	 qcom,lut-data = <1313 338 100 75 65>,
			 <1313 338 100 75 65>,
			 <1183 339 103 77 66>,
			 <1072 331 108 81 68>,
			 <1008 315 113 84 70>,
			 <985 302 119 87 71>,
			 <990 296 124 90 73>,
			 <1024 290 112 92 75>,
			 <1079 288 100 78 67>,
			 <1145 287 98 75 66>,
			 <1211 287 98 77 68>,
			 <1277 293 99 78 69>,
			 <1343 309 100 78 70>,
			 <1416 337 99 77 67>,
			 <1589 378 100 75 65>,
			 <1960 435 103 76 66>,
			 <2567 516 105 78 67>,
			 <3280 593 116 84 70>,
			 <4116 652 132 92 74>,
			 <5143 678 142 98 82>,
			 <5742 686 146 100 85>,
			 <6506 689 151 103 87>,
			 <7608 679 155 108 92>,
			 <8767 664 167 113 95>,
			 <10211 684 187 120 99>,
			 <12132 723 214 132 104>,
			 <14459 796 246 145 111>,
			 <17301 1028 287 165 121>,
			 <20714 1630 359 204 145>,
			 <25136 2673 596 348 232>,
			 <31482 5346 1192 696 464>;
	};
};
