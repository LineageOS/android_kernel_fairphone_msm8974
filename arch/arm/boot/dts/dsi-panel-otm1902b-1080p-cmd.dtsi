/* Copyright (c) 2013, The Linux Foundation. All rights reserved.
 *This program is free software; you can redistribute it and/or modify
 * it under the terms of the GNU General Public License version 2 and
 * only version 2 as published by the Free Software Foundation.
 *
 * This program is distributed in the hope that it will be useful,
 * but WITHOUT ANY WARRANTY; without even the implied warranty of
 * MERCHANTABILITY or FITNESS FOR A PARTICULAR PURPOSE.  See the
 * GNU General Public License for more details.
 */

/*---------------------------------------------------------------------------
 * This file is autogenerated file using gcdb parser. Please do not edit it.
 * Update input XML file to add a new entry or update variable in this file
 * VERSION = "1.0"
 *---------------------------------------------------------------------------*/
&mdss_mdp {
       dsi_otm1902b_1080p_cmd: qcom,mdss_dsi_otm1902b_1080p_cmd {
                qcom,mdss-dsi-panel-name = "otm1902b 1080p cmd mode dsi panel";
                qcom,mdss-pan-id = <1>;
                qcom,mdss-dsi-panel-controller = <&mdss_dsi0>;
                qcom,mdss-dsi-panel-type = "dsi_cmd_mode";
		qcom,mdss-dsi-panel-destination = "display_1";
		qcom,mdss-dsi-panel-framerate = <60>;
		qcom,mdss-dsi-virtual-channel-id = <0>;
		qcom,mdss-dsi-stream = <0>;
		qcom,mdss-dsi-panel-width = <1080>;
		qcom,mdss-dsi-panel-height = <1920>;
		qcom,mdss-dsi-h-front-porch = <144>;
		qcom,mdss-dsi-h-back-porch = <32>;
		qcom,mdss-dsi-h-pulse-width = <12>;
		qcom,mdss-dsi-h-sync-skew = <0>;
		qcom,mdss-dsi-v-back-porch = <3>;
		qcom,mdss-dsi-v-front-porch = <9>;
		qcom,mdss-dsi-v-pulse-width = <4>;
		qcom,mdss-dsi-h-left-border = <0>;
		qcom,mdss-dsi-h-right-border = <0>;
		qcom,mdss-dsi-v-top-border = <0>;
		qcom,mdss-dsi-v-bottom-border = <0>;
		qcom,mdss-dsi-bpp = <24>;
		qcom,mdss-dsi-underflow-color = <0xff>;
		qcom,mdss-dsi-border-color = <0>;
                qcom,mdss-dsi-on-command = [29 01 00 00 00 00 02 00 00
				29 01 00 00 01 00 05 FF 19 02 01 00
				29 01 00 00 01 00 02 00 80
				29 01 00 00 01 00 03 FF 19 02
				15 01 00 00 01 00 02 00 B0
				29 01 00 00 01 00 05 CA FF 02 5F 40
				15 01 00 00 01 00 02 53 2C
                                05 01 00 00 32 00 02 11 00
                                05 01 00 00 60 00 02 29 00];
                qcom,mdss-dsi-off-command = [05 01 00 00 32 00 02 28 00
                                 05 01 00 00 64 00 02 10 00];
		qcom,mdss-dsi-on-command-state = "dsi_lp_mode";
		qcom,mdss-dsi-off-command-state = "dsi_hs_mode";
		qcom,mdss-dsi-h-sync-pulse = <1>;
		qcom,mdss-dsi-traffic-mode ="burst_mode";
		qcom,mdss-dsi-lane-map;
		qcom,mdss-dsi-bllp-eof-power-mode;
		qcom,mdss-dsi-bllp-power-mode;
		qcom,mdss-pan-dsi-bllp-power-stop;
		qcom,mdss-pan-dsi-h-power-stop;
		qcom,mdss-dsi-lane-0-state;
		qcom,mdss-dsi-lane-1-state;
		qcom,mdss-dsi-lane-2-state;
		qcom,mdss-dsi-lane-3-state;
	        qcom,mdss-dsi-te-pin-select = <1>;
	        qcom,mdss-dsi-wr-mem-start = <0x2c>;
	        qcom,mdss-dsi-wr-mem-continue = <0x3c>;
                qcom,mdss-dsi-te-dcs-command = <1>;
                qcom,mdss-dsi-te-check-enable;
                qcom,mdss-dsi-te-using-te-pin;
		qcom,mdss-dsi-panel-timings = [d5 32 22 00 60 64 26 34 29 03 04 00];
		qcom,mdss-dsi-t-clk-post = <0x1e>;
                qcom,mdss-dsi-t-clk-pre = <0x38>;
		qcom,mdss-dsi-bl-min-level = <0>;
		qcom,mdss-dsi-bl-max-level = <255>;
		qcom,mdss-dsi-dma-trigger = <4>;
		qcom,mdss-dsi-mdp-trigger = <0>;
		qcom,mdss-dsi-bl-pmic-control-type = "bl_ctrl_dcs";
		qcom,mdss-dsi-reset-sequence = <1 20>, <0 2>, <1 10>;
		qcom,mdss-pan-physical-width-dimension = <62>;
		qcom,mdss-pan-physical-height-dimension = <110>;
	};
};
