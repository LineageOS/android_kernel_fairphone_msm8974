/* Copyright (c) 2013, The Linux Foundation. All rights reserved.
 *
 * This program is free software; you can redistribute it and/or modify
 * it under the terms of the GNU General Public License version 2 and
 * only version 2 as published by the Free Software Foundation.
 *
 * This program is distributed in the hope that it will be useful,
 * but WITHOUT ANY WARRANTY; without even the implied warranty of
 * MERCHANTABILITY or FITNESS FOR A PARTICULAR PURPOSE.  See the
 * GNU General Public License for more details.
 */

/*---------------------------------------------------------------------------
 * This file is autogenerated file using gcdb parser. Please do not edit it.
 * Update input XML file to add a new entry or update variable in this file
 * VERSION = "1.0"
 *---------------------------------------------------------------------------*/

&mdss_mdp {
	dsi_s6d6fa1_1080p_video: qcom,mdss_dsi_s6d6fa1_1080p_video{
		qcom,mdss-dsi-panel-name = "S6D6FA1 1080p video mode dsi panel";
                qcom,mdss-pan-id = <2>;
		qcom,mdss-dsi-panel-controller = <&mdss_dsi0>;
		qcom,mdss-dsi-panel-type = "dsi_video_mode";
		qcom,mdss-dsi-panel-destination = "display_1";
		qcom,mdss-dsi-panel-framerate = <57>;
		qcom,mdss-dsi-virtual-channel-id = <0>;
		qcom,mdss-dsi-stream = <0>;
		qcom,mdss-dsi-panel-width = <1080>;
		qcom,mdss-dsi-panel-height = <1920>;
		qcom,mdss-dsi-h-front-porch = <216>;
		qcom,mdss-dsi-h-back-porch = <52>;
		qcom,mdss-dsi-h-pulse-width = <16>;
		qcom,mdss-dsi-h-sync-skew = <0>;
		qcom,mdss-dsi-v-back-porch = <3>;
		qcom,mdss-dsi-v-front-porch = <4>;
		qcom,mdss-dsi-v-pulse-width = <1>;
		qcom,mdss-dsi-h-left-border = <0>;
		qcom,mdss-dsi-h-right-border = <0>;
		qcom,mdss-dsi-v-top-border = <0>;
		qcom,mdss-dsi-v-bottom-border = <0>;
		qcom,mdss-dsi-bpp = <24>;
		qcom,mdss-dsi-color-order = "rgb_swap_rgb";
		qcom,mdss-dsi-underflow-color = <0xff>;
		qcom,mdss-dsi-border-color = <0>;
		qcom,mdss-dsi-on-command = [
			/* Initial_Seq */
			29 01 00 00 00 00 03
				F0 5A 5A
			29 01 00 00 00 00 03
				F1 5A 5A
			29 01 00 00 00 00 03
				FC 5A 5A
			29 01 00 00 00 00 08
				F5 10 18 00
				D1 A7 11 08
			29 01 00 00 00 00 07
				B3 10 F0 00
				BB 04 08
			29 01 00 00 00 00 07
				B6 29 10 2C
				64 64 01
			29 01 00 00 00 00 0F
				B7 00 00 00
				00 00 C0 00
				09 03 F5 00
				00 00 00
			29 01 00 00 00 00 1C
				B8 3B 00 18
				18 03 21 11
				00 83 F4 BB
				00 03 1E 21
				00 BE BB 0B
				E0 70 FF FF
				00 20 00 00
			29 01 00 00 00 00 1C
				B9 1D 00 18
				18 03 00 11
				00 02 F4 BB
				00 03 00 00
				11 86 83 18
				61 20 FF FF
				00 40 00 00
			29 01 00 00 00 00 1C
				BA 3B 00 18
				18 03 21 11
				00 83 F4 BB
				00 03 1E 21
				00 BE BB 0B
				E0 70 FF FF
				00 20 00 00
			29 01 00 00 00 00 1C
				BB 3B 00 18
				18 03 21 11
				00 83 F4 BB
				00 03 1E 21
				00 BE BB 0B
				E0 70 FF FF
				00 20 00 00
			29 01 00 00 00 00 18
				BC 20 80 3C
				19 01 02 06
				00 00 2D 06
				0F 13 0B 1E
				04 02 2A 00
				00 02 00 99
			29 01 00 00 00 00 15
				BD 01 07 07
				07 00 00 00
				00 05 01 00
				00 00 40 00
				05 2D 05 05
				05
			29 01 00 00 00 00 2C
				BE 00 00 00
				00 00 00 02
				0B 0A 0B 07
				0B 04 06 02
				01 00 09 0B
				0E 0D 0C 11
				10 0F 0B 0B
				0B 0B 12 03
				05 02 01 00
				08 0B 0E 0D
				0C 11 10 0F
			29 01 00 00 00 00 0F
				BF 00 00 00
				00 0C CC CC
				CC CC 0C C6
				CC C7 CC
			29 01 00 00 00 00 02
				D0 08
			29 01 00 00 00 00 02
				E3 22
			29 01 00 00 00 00 08
				E8 00 03 10
				04 02 06 D0
			29 01 00 00 00 00 07
				F2 46 43 13
				33 C1 16
			29 01 00 00 00 00 1C
				F4 50 50 70
				14 14 14 14
				06 16 26 00
				6E 1F 14 0E
				C9 02 55 35
				54 AA 55 05
				04 44 48 30
			29 01 00 00 00 00 05
				F7 00 00 3F
				FF
			29 01 00 00 00 00 53
				FA 05 7C 19
				21 2D 39 3F
				45 48 48 56
				5B 3C 3D 3D
				46 43 3E 41
				3D 3A 3A 23
				23 26 2B 1A
				05 7C 19 22
				2E 3A 40 45
				48 48 56 5B
				3C 3D 3D 46
				44 3F 42 3E
				3B 3B 25 24
				27 2C 1A 05
				7C 22 2F 39
				43 48 4C 4D
				4C 5A 5E 3E
				3F 3E 46 44
				3E 41 3D 3A
				3A 23 22 25
				2B 1A 00
			29 01 00 00 00 00 52
				FB 05 7C 19
				21 2D 39 3F
				45 48 48 56
				5B 3C 3D 3D
				46 43 3E 41
				3D 3A 3A 23
				23 26 2B 1A
				05 7C 19 22
				2E 3A 40 45
				48 48 56 5B
				3C 3D 3D 46
				44 3F 42 3E
				3B 3B 25 24
				27 2C 1A 05
				7C 22 2F 39
				43 48 4C 4D
				4C 5A 5E 3E
				3F 3E 46 44
				3E 41 3D 3A
				3A 23 22 25
				2B 1A
			29 01 00 00 00 00 03
				F0 A5 A5
			29 01 00 00 00 00 03
				F1 A5 A5
			29 01 00 00 00 00 03
				FC A5 A5
			/* NWM write*/
			/*29 01 00 00 00 00 03
				F0 5A 5A
			29 01 00 00 00 00 03
				F1 5A 5A
			29 01 00 00 00 00 03
				F0 5A 5A
			29 01 00 00 00 00 03
				F1 5A 5A
			29 01 00 00 00 00 02
				D0 01
			29 01 00 00 00 00 02
				D0 00
			29 01 00 00 00 00 03
				F0 5A 5A
			29 01 00 00 00 00 03
				F1 5A 5A*/
			15 01 00 00 01 00 02 51 FF		/* Brightness */
			15 01 00 00 01 00 02 53 2C		/* CTRL Display */
			15 01 00 00 01 00 02 55 00		/* CABC Effect */
			15 01 00 00 01 00 02 35 00		/* Set tear on */
			05 01 00 00 78 00 02 11 00		/* Exit sleep, wait 120ms */
			05 01 00 00 28 00 02 29 00		/* Display on */
			];
		qcom,mdss-dsi-off-command = [05 01 00 00 14 00 02 28 00		/* Display off, wait 20ms */
					05 01 00 00 50 00 02 10 00];		/* Enter sleep, wait 80ms */
		qcom,mdss-dsi-on-command-state = "dsi_lp_mode";
		qcom,mdss-dsi-off-command-state = "dsi_hs_mode";
		qcom,mdss-dsi-h-sync-pulse = <1>;
		qcom,mdss-dsi-traffic-mode = "burst_mode";
		qcom,mdss-dsi-lane-map;
		qcom,mdss-dsi-bllp-eof-power-mode;
		qcom,mdss-dsi-bllp-power-mode;
		qcom,mdss-pan-dsi-bllp-power-stop;
		qcom,mdss-pan-dsi-h-power-stop;
		qcom,mdss-dsi-lane-0-state;
		qcom,mdss-dsi-lane-1-state;
		qcom,mdss-dsi-lane-2-state;
		qcom,mdss-dsi-lane-3-state;
		qcom,mdss-dsi-panel-timings = [E6 38 26 00 68 6E 2A 3C 2C 03 04 00]; /* 900Mbps */
		qcom,mdss-dsi-t-clk-post = <0x03>;
		qcom,mdss-dsi-t-clk-pre = <0x2b>;
		qcom,mdss-dsi-bl-min-level = <0>;
		qcom,mdss-dsi-bl-max-level = <255>;
		qcom,mdss-dsi-dma-trigger = "trigger_sw";
		qcom,mdss-dsi-mdp-trigger = "none";
		qcom,mdss-dsi-bl-pmic-control-type = "bl_ctrl_dcs";
		qcom,mdss-dsi-reset-sequence = <1 10>, <0 10>, <1 10>;
		qcom,mdss-pan-physical-width-dimension = <62>;
		qcom,mdss-pan-physical-height-dimension = <110>;
	};
};
